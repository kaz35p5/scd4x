
/dts-v1/;
/plugin/;

/ {
    compatible = "brcm,bcm2835";

    fragment@0 {
        target = <&i2cbus>;
        __dormant__ {
            #address-cells = <1>;
            #size-cells = <0>;

            scd40: scd40@62 {
                compatible = "sensirion,scd40";
                reg = <0x62>;
            };
        };
    };

    fragment@1 {
        target = <&i2cbus>;
        __dormant__ {
            #address-cells = <1>;
            #size-cells = <0>;

            scd41: scd41@62 {
                compatible = "sensirion,scd41";
                reg = <0x62>;
            };
        };
    };

	__overrides__ {
		scd40 = <0>,"+0";
		scd41 = <0>,"+1";
    };
};


/ {
	frag100: fragment@100 {
		target = <&i2c_arm>;
		i2cbus: __overlay__ {
			status = "okay";
		};
	};

	fragment@101 {
		target = <&i2c0if>;
		__dormant__ {
			status = "okay";
		};
	};

	fragment@102 {
		target = <&i2c0mux>;
		__dormant__ {
			status = "okay";
		};
	};

	__overrides__ {
		i2c0 = <&frag100>, "target:0=",<&i2c0>;
		i2c_csi_dsi = <&frag100>, "target:0=",<&i2c_csi_dsi>,
			      <0>,"+101+102";
		i2c3 = <&frag100>, "target?=0",
		       <&frag100>, "target-path=i2c3";
		i2c4 = <&frag100>, "target?=0",
		       <&frag100>, "target-path=i2c4";
		i2c5 = <&frag100>, "target?=0",
		       <&frag100>, "target-path=i2c5";
		i2c6 = <&frag100>, "target?=0",
		       <&frag100>, "target-path=i2c6";
	};
};
